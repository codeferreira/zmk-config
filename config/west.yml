## config/west.yml
```yaml
manifest:
  remotes:
    - name: zmkfirmware
      url-base: https://github.com/zmkfirmware
  projects:
    - name: zmk
      remote: zmkfirmware
      revision: main
      import: app/west.yml
    - name: zmk-nice-nano
      url: https://github.com/nicekeyboards/zmk-nice-nano
      revision: main
      path: modules/hardware/nice_nano
  self:
    path: config
```
